## configs/ts7840_spi_defconfig
```kconfig
# CONFIG_CMD_FLASH is not set
# CONFIG_CMD_IMLS is not set
# CONFIG_CMD_SETEXPR is not set
# CONFIG_DISPLAY_BOARDINFO is not set
# CONFIG_SPL_PARTITION_UUIDS is not set
CONFIG_TARGET_TS7840=y
CONFIG_ARCH_MVEBU=y
CONFIG_ARM=y
CONFIG_AUTOBOOT_KEYED=y
CONFIG_AUTOBOOT_KEYED_CTRLC=y
CONFIG_AUTOBOOT_PROMPT="Press ESC twice to abort autoboot in %d second(s)\n"
CONFIG_AUTOBOOT_STOP_STR="\x1b\x1b"
CONFIG_BOOTDELAY=3
CONFIG_CMD_CACHE=y
CONFIG_CMD_I2C=y
CONFIG_CMD_MMC=y
CONFIG_CMD_PCI=y
CONFIG_CMD_SF=y
CONFIG_CMD_SPI=y
CONFIG_CMD_TFTPPUT=y
CONFIG_CMD_TIME=y
CONFIG_CMD_USB=y
CONFIG_CMD_MD5SUM=y
CONFIG_DEBUG_UART=y
CONFIG_DEBUG_UART_BASE=0xd0012000
CONFIG_DEBUG_UART_CLOCK=250000000
CONFIG_DEBUG_UART_SHIFT=2
CONFIG_DEFAULT_DEVICE_TREE="armada-385-ts7840"
CONFIG_DISTRO_DEFAULTS=y
CONFIG_DM_USB=y
CONFIG_ENV_IS_IN_SPI_FLASH=y
CONFIG_LIB_RAND=y
CONFIG_MMC_SDHCI=y
CONFIG_MMC_SDHCI_MV=y
CONFIG_MMC_SDHCI_SDMA=y
CONFIG_PCI=y
CONFIG_PHY_GIGE=y
CONFIG_PHYLIB=y
CONFIG_SPI_FLASH=y
CONFIG_SPL=y
CONFIG_SPL_I2C_SUPPORT=y
CONFIG_SPL_LIBCOMMON_SUPPORT=y
CONFIG_SPL_LIBDISK_SUPPORT=y
CONFIG_SPL_LIBGENERIC_SUPPORT=y
CONFIG_SPL_OF_TRANSLATE=y
CONFIG_SPL_SERIAL_SUPPORT=y
CONFIG_SPL_SPI_FLASH_SUPPORT=y
CONFIG_SPL_SPI_SUPPORT=y
CONFIG_SYS_CONSOLE_INFO_QUIET=y
CONFIG_SYS_HUSH_PARSER=y
CONFIG_SYS_MALLOC_F_LEN=0x2000
CONFIG_SYS_MMCSD_RAW_MODE_U_BOOT_SECTOR=0x140
CONFIG_SYS_NS16550=y
CONFIG_SYS_THUMB_BUILD=y
CONFIG_USB=y
CONFIG_USB_EHCI_HCD=y
CONFIG_USB_XHCI_HCD=y
CONFIG_USB_STORAGE=y
CONFIG_LED_STATUS=y
CONFIG_LED_STATUS0=y
CONFIG_LED_STATUS_BIT=1
CONFIG_LED_STATUS_STATE=0
CONFIG_LED_STATUS1=y
CONFIG_LED_STATUS_BIT1=2
CONFIG_LED_STATUS_STATE1=1
CONFIG_LED_STATUS_CMD=y
CONFIG_TS7800V2_WATCHDOG=y
CONFIG_HW_WATCHDOG=y
CONFIG_SPL_WATCHDOG_SUPPORT=y
CONFIG_SCSI=y
```
